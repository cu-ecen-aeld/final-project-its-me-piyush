## meta-ai-assistant/conf/layer.conf
```bitbake
# We have a conf and classes directory, add to BBPATH
BBPATH .= ":${LAYERDIR}"

# We have recipes-* directories, add to BBFILES
BBFILES += "${LAYERDIR}/recipes-*/*/*.bb \
            ${LAYERDIR}/recipes-*/*/*.bbappend"

BBFILE_COLLECTIONS += "meta-ai-assistant"
BBFILE_PATTERN_meta-ai-assistant = "^${LAYERDIR}/"
BBFILE_PRIORITY_meta-ai-assistant = "6"

LAYERDEPENDS_meta-ai-assistant = "core"
LAYERSERIES_COMPAT_meta-ai-assistant = "styhead"
```
